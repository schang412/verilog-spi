## meta-a32v-spi/conf/layer.conf
```bitbake
BBPATH .= ":${LAYERDIR}"
BBFILES += "${LAYERDIR}/recipes-*/*/*.bb ${LAYERDIR}/recipes-*/*/*.bbappend ${LAYERDIR}/recipes-*/*/*/*.bb"
BBFILE_COLLECTIONS += "meta-a32v-spi"
BBFILE_PATTERN_meta-a32v-spi = "^${LAYERDIR}/"
BBFILE_PRIORITY_meta-a32v-spi = "5"
LAYERSERIES_COMPAT_meta-a32v-spi = "gatesgarth"
```
